## boards/shields/cradio/Kconfig.defconfig
```kconfig
# Copyright (c) 2020 The ZMK Contributors
# SPDX-License-Identifier: MIT

if SHIELD_CRADIO_LEFT || SHIELD_CRADIO_LEFT_PATCHED_BROKEN_PIN6

# Lets call the board what it is actually named...
config ZMK_KEYBOARD_NAME
    default "Ferris Sweep"

config ZMK_SPLIT_ROLE_CENTRAL
    default y

endif

if SHIELD_CRADIO_LEFT || SHIELD_CRADIO_LEFT_PATCHED_BROKEN_PIN6 || SHIELD_CRADIO_RIGHT

config ZMK_SPLIT
    default y

endif
```

## boards/shields/cradio/Kconfig.shield
```kconfig
# Copyright (c) 2020 The ZMK Contributors
# SPDX-License-Identifier: MIT

config SHIELD_CRADIO_LEFT_PATCHED_BROKEN_PIN6
	def_bool $(shields_list_contains,cradio_left_patched_broken_pin6)

config SHIELD_CRADIO_LEFT
	def_bool $(shields_list_contains,cradio_left)

config SHIELD_CRADIO_RIGHT
	def_bool $(shields_list_contains,cradio_right)
```

## boards/shields/ferris_sweep/Kconfig.defconfig
```kconfig
# Copyright (c) 2020 The ZMK Contributors
# SPDX-License-Identifier: MIT

if SHIELD_FERRIS_SWEEP_LEFT || SHIELD_FERRIS_SWEEP_LEFT_PATCHED_BROKEN_PIN6

# Lets call the board what it is actually named...
config ZMK_KEYBOARD_NAME
    default "Ferris Sweep"

config ZMK_SPLIT_ROLE_CENTRAL
    default y

endif

if SHIELD_FERRIS_SWEEP_LEFT || SHIELD_FERRIS_SWEEP_LEFT_PATCHED_BROKEN_PIN6 || SHIELD_FERRIS_SWEEP_RIGHT

config ZMK_SPLIT
    default y

endif
```

## boards/shields/ferris_sweep/Kconfig.shield
```kconfig
# Copyright (c) 2020 The ZMK Contributors
# SPDX-License-Identifier: MIT

config SHIELD_FERRIS_SWEEP_LEFT_PATCHED_BROKEN_PIN6
	def_bool $(shields_list_contains,FERRIS_SWEEP_left_patched_broken_pin6)

config SHIELD_FERRIS_SWEEP_LEFT
	def_bool $(shields_list_contains,FERRIS_SWEEP_left)

config SHIELD_FERRIS_SWEEP_RIGHT
	def_bool $(shields_list_contains,FERRIS_SWEEP_right)
```
